## packages/virgo-pycdm/virgo_pycdm-0.3.2.tar.gz/virgo_pycdm-0.3.2/common-cdm/common/Kconfig.projbuild
```kconfig
menu "Virgo common"
  choice
  prompt "Olimex board"

    config EBI_OLIMEX_GATEWAY
		  bool "Olimex gateway board"

    config EBI_OLIMEX_POE
		  bool "Olimex PoE board"
  endchoice
endmenu
```
